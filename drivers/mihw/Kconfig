## drivers/mihw/Kconfig
```kconfig
config CFS_BANDWIDTH_MI
	tristate "cfs bandwidth by xiaomi"
	default n

config MI_PERFMGR
	tristate "Frame Energy Aware Scheduling"
	help
	  More power saving while meeting performance

config MI_SPEED_TOUCH
	tristate "mi speed touch"
	depends on MIHW
	help
	  The case is used to monitor speed touch

config MI_DCVS_ARBI
        tristate "mi dcvs arbi"
        default n
        help
          The case is used to manager multi voter clients of dcvs
```

## drivers/power/supply/lc_chg/charger_policy/Kconfig
```kconfig
#SPDX-License-Identifier: GPL-2.0

config LC_CHARGER_MANAGER
	tristate "support lc charger manger"
	default n
	help
		Say Y here to support lc charger manger.

config LC_CHARGER_MANAGER
	tristate "support lc battery secret"
	depends on LC_BATTERY_SECRET
	help
		Say Y here to support lc battery secret.

config LC_CP_POLICY
	tristate "support lc charger pump policy"
	default n
	help
		Say Y here to support lc charger class.

config LC_PD_POLICY
	tristate "support lc pd policy"
	default n
	help
		Say Y here to support lc charger class.

config LC_QC_POLICY
	tristate "support lc qc policy"
	default n
	help
		Say Y here to support lc charger class.

config XM_DFX_CHARGER
	tristate "support dfs Charger"
	default n
	help
		Say Y here to support dfs Charger.
config LC_REPLENISH
	tristate "support lc replenish"
	default n
	help
		Say Y here to support lc charger class.
```

## drivers/power/supply/lc_chg/fuelgauge/Kconfig
```kconfig
#SPDX-License-Identifier: GPL-2.0

config SM_FUELGAUGE
	tristate "sm5602_fg fuelgauge"
	default n
	help
		Say Y here to support sm5602_fg fuelgauge.

config CHARGE_PARTITION
	tristate "charge partition"
    depends on SM_FUELGAUGE
    help
	  charge partition write/read in kernel
```

## drivers/scsi/mi_ufs/Kconfig
```kconfig
# SPDX-License-Identifier: GPL-2.0-only
#
# MI UFS feature configuration
#
source "drivers/scsi/mi_ufs/cld/Kconfig"
source "drivers/scsi/mi_ufs/wb_check/Kconfig"
source "drivers/scsi/mi_ufs/mi_ffu/Kconfig"
source "drivers/scsi/mi_ufs/mi-memory/Kconfig"

config UFS_WB
	bool "UFS WB"
	depends on SCSI_UFS_QCOM
```

## drivers/scsi/mi_ufs/cld/Kconfig
```kconfig
# SPDX-License-Identifier: GPL-2.0-only
#
# Mi ufs cld
#
config MI_MEMORY_CLD
	bool "Xiaomi UFS CLD"
	depends on SCSI_UFS_QCOM
	default y
	help
	  This adds support for Xiaomi CLD driver support.
```

## drivers/scsi/mi_ufs/mi_ffu/Kconfig
```kconfig
# SPDX-License-Identifier: GPL-2.0-only
#
# Mi ufs ffu
#
config MI_UFS_FFU
	bool "Xiaomi kernel FFU"
	depends on SCSI_UFS_QCOM
	default y
	help
	  This adds support for Xiaomi FFU driver support.
```

## drivers/scsi/mi_ufs/wb_check/Kconfig
```kconfig
# SPDX-License-Identifier: GPL-2.0-only
#
# Mi ufs wb_check
#
config UFS_WB_CHECK
	bool "UFS WB CHECK"
	depends on SCSI_UFS_QCOM
	default y
	help
	  Kernel configuration file for UFS WB feature
```
